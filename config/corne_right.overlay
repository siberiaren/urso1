/*
 * Corne Right half custom pin overlay
 */

/ {
    chosen {
        zmk,kscan = &kscan;
    };
};

&kscan {
    // Definindo os pinos das COLUNAS para o lado DIREITO
    col-gpios =
        <&gpio0 6 (GPIO_ACTIVE_HIGH | GPIO_PULL_DOWN)>   /* col0 */
        , <&gpio0 7 (GPIO_ACTIVE_HIGH | GPIO_PULL_DOWN)>   /* col1 */
        , <&gpio0 15 (GPIO_ACTIVE_HIGH | GPIO_PULL_DOWN)>  /* col2 */
        , <&gpio0 16 (GPIO_ACTIVE_HIGH | GPIO_PULL_DOWN)>  /* col3 */
        , <&gpio0 9 (GPIO_ACTIVE_HIGH | GPIO_PULL_DOWN)>   /* col4 */
        , <&gpio0 14 (GPIO_ACTIVE_HIGH | GPIO_PULL_DOWN)>  /* col5 */
        , <&gpio0 20 (GPIO_ACTIVE_HIGH | GPIO_PULL_DOWN)>  /* col6 */
        ;

    // Definindo os pinos das LINHAS para o lado DIREITO
    row-gpios =
        <&gpio0 5 (GPIO_ACTIVE_HIGH | GPIO_PULL_UP)>   /* row0 */
        , <&gpio0 8 (GPIO_ACTIVE_HIGH | GPIO_PULL_UP)>   /* row1 */
        , <&gpio0 10 (GPIO_ACTIVE_HIGH | GPIO_PULL_UP)>  /* row2 */
        , <&gpio0 18 (GPIO_ACTIVE_HIGH | GPIO_PULL_UP)>  /* row3 */
        , <&gpio0 19 (GPIO_ACTIVE_HIGH | GPIO_PULL_UP)>  /* row4 */
        ;
};
